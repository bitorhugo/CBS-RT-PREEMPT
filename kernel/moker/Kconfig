## kernel/moker/Kconfig
```kconfig
menu "MOKER framework"
config MOKER_FRAMEWORK
bool "My Own KERnel Framework"
default y

config MOKER_TRACING
bool "MOKER tracing"
default y
depends on MOKER_FRAMEWORK

config MOKER_SCHED_CBS_POLICY
bool "MOKER scheduling policy: CBS"
default y
depends on MOKER_FRAMEWORK

endmenu
```
